## config/boards/shields/a_ball/Kconfig.defconfig
```kconfig
if SHIELD_a_ball

config ZMK_KEYBOARD_NAME
    default "a_ball"
 
config I2C
	default y

endif 
```

## config/boards/shields/a_ball_d/Kconfig.defconfig
```kconfig
if SHIELD_A_BALL_D|| SHIELD_A_BALL_D_LEFT || SHIELD_A_BALL_D_RIGHT
config ZMK_SPLIT
	default y
config ZMK_POINTING
    default y
endif

if SHIELD_A_BALL_D_DONGLE
config ZMK_KEYBOARD_NAME
	default "ThumbsUp! Trackball"
config ZMK_SPLIT_ROLE_CENTRAL
	default y
# Set this to the number of peripherals your dongle will have.
# For a unibody, this would be 1. If you have left and right halves, set it to 2, etc.
config ZMK_SPLIT_BLE_CENTRAL_PERIPHERALS
    default 1

# Set this to ZMK_SPLIT_BLE_CENTRAL_PERIPHERALS + your desired number of BT profiles (default is 5)
config BT_MAX_CONN
    default 6

# Set this to the same number as BT_MAX_CONN
config BT_MAX_PAIRED
    default 6
endif

if SHIELD_A_BALL_D_RIGHT
config SPI
    default y
endif
```

## config/boards/shields/a_ball_d/Kconfig.shield
```kconfig
# No whitespace after the comma or in your part name!

config SHIELD_A_BALL_D_L
    def_bool $(shields_list_contains,a_ball_d_l)

config SHIELD_A_BALL_D_R
    def_bool $(shields_list_contains,a_ball_d_r)

config SHIELD_A_BALL_D_D
	def_bool $(shields_list_contains,a_ball_d_d)
```

## config/boards/shields/a_ball_w_dongle/Kconfig.defconfig
```kconfig
if SHIELD_A_BALL_DONGLE || SHIELD_A_BALL_LEFT || SHIELD_A_BALL_RIGHT
config ZMK_SPLIT
	default y
config ZMK_POINTING
    default y
endif

if SHIELD_A_BALL_DONGLE
config ZMK_KEYBOARD_NAME
	default "ThumbsUp! Trackball"
config ZMK_SPLIT_ROLE_CENTRAL
	default y
endif

if SHIELD_A_BALL_RIGHT
config SPI
    default y
endif
```

## config/boards/shields/a_ball_w_dongle/Kconfig.shield
```kconfig
# No whitespace after the comma or in your part name!

config SHIELD_A_BALL_LEFT
    def_bool $(shields_list_contains,a_ball_left)

config SHIELD_A_BALL_RIGHT
    def_bool $(shields_list_contains,a_ball_right)

config SHIELD_A_BALL_DONGLE
	def_bool $(shields_list_contains,a_ball_dongle)
```

## config/west.yml
```yaml
manifest:
  remotes:
    - name: zmkfirmware
      url-base: https://github.com/zmkfirmware
    - name: george-norton
      url-base: https://github.com/george-norton
    # Additional modules containing boards/shields/custom code can be listed here as well
    # See https://docs.zephyrproject.org/3.2.0/develop/west/manifest.html#projects
  projects:
    - name: zmk
      remote: zmkfirmware
      revision: main
      import: app/west.yml
    - name: pmw3360-zephyr-module
      remote: george-norton
      revision: main
  self:
    path: config
```
